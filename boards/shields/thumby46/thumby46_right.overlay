#include "thumby46.dtsi"

&default_transform { // Offset of 5 because the left side has 5 columns
    col-offset = <5>;
};

&kscan0 {
    col-gpios
        = <&gpio1 0 GPIO_ACTIVE_HIGH>
        , <&gpio0 24 GPIO_ACTIVE_HIGH>
        , <&gpio0 22 GPIO_ACTIVE_HIGH>
        , <&gpio0 20 GPIO_ACTIVE_HIGH>
        , <&gpio0 17 GPIO_ACTIVE_HIGH>
        ;
    row-gpios
        = <&gpio0 31 (GPIO_ACTIVE_HIGH | GPIO_PULL_DOWN)>
        , <&gpio0 29 (GPIO_ACTIVE_HIGH | GPIO_PULL_DOWN)>
        , <&gpio0 2 (GPIO_ACTIVE_HIGH | GPIO_PULL_DOWN)>
        , <&gpio1 15 (GPIO_ACTIVE_HIGH | GPIO_PULL_DOWN)>
        , <&gpio1 13 (GPIO_ACTIVE_HIGH | GPIO_PULL_DOWN)>
        ;
};

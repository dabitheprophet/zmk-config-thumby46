## boards/shields/thumby46/Kconfig.defconfig
```kconfig
if SHIELD_THUMBY46_LEFT

config ZMK_KEYBOARD_NAME
    default "Thumby46"

config ZMK_SPLIT_ROLE_CENTRAL
    default y

endif

if SHIELD_THUMBY46_LEFT || SHIELD_THUMBY46_RIGHT

config ZMK_SPLIT
    default y

endif
```

## boards/shields/thumby46/Kconfig.shield
```kconfig
config SHIELD_THUMBY46_LEFT
    def_bool $(shields_list_contains,thumby46_left)

config SHIELD_THUMBY46_RIGHT
    def_bool $(shields_list_contains,thumby46_right)
```
